/*
 * NiceNano v2 Keymap Configuration
 *
 * SPDX-License-Identifier: MIT
 */

#include <behaviors.dtsi>
#include <dt-bindings/zmk/keys.h>
#include <dt-bindings/zmk/bt.h>

&keymap {
    compatible = "zmk,keymap";

    default_layer {
        bindings = <
            // First Row
            &kp ESC    &kp N1   &kp N2   &kp N3   &kp N4   &kp N5   &kp N6   &kp N7   &kp N8   &kp N9   &kp N0   &kp MINUS &kp EQUAL  &kp BSPC
            // Second Row
            &kp TAB    &kp Q    &kp W    &kp E    &kp R    &kp T    &kp Y    &kp U    &kp I    &kp O    &kp P    &kp LBKT  &kp RBKT   &kp BSLH
            // Third Row
            &kp CLCK   &kp A    &kp S    &kp D    &kp F    &kp G    &kp H    &kp J    &kp K    &kp L    &kp SEMI &kp SQT              &kp RET
            // Fourth Row
            &kp LSHFT  &kp Z    &kp X    &kp C    &kp V    &kp B    &kp N    &kp M    &kp COMMA &kp DOT  &kp FSLH            &kp RSHFT
            // Bottom Row
            &kp LCTRL  &kp LGUI &kp LALT &kp SPACE                               &kp RALT &kp RGUI &mo 1  &kp RCTRL
        >;
    };

    // Optional Layer: Secondary functions (adjust as needed)
    function_layer {
        bindings = <
            // First Row
            &bt BT_CLR &kp F1   &kp F2   &kp F3   &kp F4   &kp F5   &kp F6   &kp F7   &kp F8   &kp F9   &kp F10  &kp F11   &kp F12    &kp DEL
            // Second Row
            &bt BT_SEL 0 &trans &kp UP   &trans   &kp LEFT &kp DOWN &kp RIGHT &trans  &trans  &trans   &trans   &trans    &trans     &trans
            // Third Row
            &bt BT_SEL 1 &kp LEFT &kp DOWN &kp RIGHT &trans &trans &trans &trans &trans &trans &trans &trans              &trans
            // Fourth Row
            &bt BT_SEL 2 &trans &trans &trans &trans &trans &trans &trans &trans &trans &trans          &trans
            // Bottom Row
            &bt BT_SEL 3 &trans &trans &trans                               &trans &trans &trans &trans
        >;
    };
};
